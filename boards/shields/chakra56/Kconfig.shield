## boards/shields/chakra56/Kconfig.shield
```kconfig
# SPDX-License-Identifier: MIT

config SHIELD_CHAKRA56_LEFT
    def_bool $(shields_list_contains,chakra56_left)

config SHIELD_CHAKRA56_RIGHT
    def_bool $(shields_list_contains,chakra56_right)
```
